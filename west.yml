## west.yml
```yaml
# NCS Workflow 4: Application as the manifest repo
# https://developer.nordicsemi.com/nRF_Connect_SDK/doc/latest/nrf/dm_adding_code.html
manifest:
  remotes:
    - name: nrfconnect
      url-base: https://github.com/nrfconnect/
    - name: MirkoCovizzi
      url-base: https://github.com/MirkoCovizzi/
  projects:
    - name: sdk-nrf
      path: nrf
      revision: deinit-crash
      remote: MirkoCovizzi
      import: true

  self:
    path: modules/lib/onomondo-softsim
 
```
